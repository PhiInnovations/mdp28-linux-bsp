## meta-phi/conf/bblayers.conf.sample
```bitbake
# LAYER_CONF_VERSION is increased each time build/conf/bblayers.conf
# changes incompatibly
LCONF_VERSION = "6"

BBPATH = "${TOPDIR}"
BBFILES ?= ""

BBLAYERS ?= " \
  ##COREBASE##/meta \
  ##COREBASE##/meta-yocto \
  ##COREBASE##/openembedded-core/meta \
  ##COREBASE##/meta-fsl-arm \
  ##COREBASE##/meta-openembedded/meta-oe \
  ##COREBASE##/meta-phi \
  "
BBLAYERS_NON_REMOVABLE ?= " \
  ##COREBASE##/meta \
  ##COREBASE##/meta-yocto \
  "
```

## meta-phi/conf/machine/mdp28.conf
```bitbake
#@TYPE: Machine
#@NAME: MDP28 System On Module
#@DESCRIPTION: 

include conf/machine/include/mxs-base.inc

SOC_FAMILY = "mxs:mx28"

IMXBOOTLETS_MACHINE = "iMX28_EVK"
UBOOT_MACHINE = "mx28evk_config"

KERNEL_IMAGETYPE = "uImage"
KERNEL_DEVICETREE = "${S}/arch/arm/boot/dts/imx28-evk.dts"

SDCARD_ROOTFS ?= "${DEPLOY_DIR_IMAGE}/${IMAGE_NAME}.rootfs.ext3"
IMAGE_FSTYPES ?= "tar.bz2 ext3 sdcard ubi"

SERIAL_CONSOLE = "115200 ttyAMA0"

KERNEL_IMAGETYPE = "uImage"

MACHINE_FEATURES = "apm usbgadget usbhost vfat"

MKUBIFS_ARGS = "-m 2048 -e 126976 -c 3967"
UBI_VOLNAME = "filesystem"
UBINIZE_ARGS = "--min-io-size=2048 --peb-size=128KiB -s 2048"
```
